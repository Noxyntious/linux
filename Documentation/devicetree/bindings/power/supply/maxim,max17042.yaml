## Documentation/devicetree/bindings/power/supply/maxim,max17042.yaml
```yaml
# SPDX-License-Identifier: GPL-2.0
%YAML 1.2
---
$id: http://devicetree.org/schemas/power/supply/maxim,max17042.yaml#
$schema: http://devicetree.org/meta-schemas/core.yaml#

title: Maxim 17042 fuel gauge series

maintainers:
  - Sebastian Reichel <sre@kernel.org>

allOf:
  - $ref: power-supply.yaml#

properties:
  compatible:
    enum:
      - maxim,max17042
      - maxim,max17047
      - maxim,max17050
      - maxim,max17055
      - maxim,max77705-battery
      - maxim,max77759-fg
      - maxim,max77849-battery

  reg:
    maxItems: 1

  interrupts:
    maxItems: 1
    description:
      The ALRT pin (or FG_INTB pin on MAX77759), an open-drain interrupt.

  shunt-resistor-micro-ohms:
    description:
      Resistance of rsns resistor in micro Ohms (datasheet-recommended value is 10000).
      Defining this property enables current-sense functionality.

  maxim,rsns-microohm:
    deprecated: true
    $ref: /schemas/types.yaml#/definitions/uint32
    description:
      Resistance of rsns resistor in micro Ohms (datasheet-recommended value is 10000).
      Defining this property enables current-sense functionality.

  maxim,cold-temp:
    $ref: /schemas/types.yaml#/definitions/int32
    description:
      Temperature threshold to report battery as cold (in tenths of degree Celsius).
      Default is not to report cold events.

  maxim,over-heat-temp:
    $ref: /schemas/types.yaml#/definitions/int32
    description:
      Temperature threshold to report battery as over heated (in tenths of degree Celsius).
      Default is not to report over heating events.

  maxim,dead-volt:
    $ref: /schemas/types.yaml#/definitions/uint32
    description:
      Voltage threshold to report battery as dead (in mV).
      Default is not to report dead battery events.

  maxim,over-volt:
    $ref: /schemas/types.yaml#/definitions/uint32
    description:
      Voltage threshold to report battery as over voltage (in mV).
      Default is not to report over-voltage events.

  maxim,thermistor-tgain:
    $ref: /schemas/types.yaml#/definitions/uint32
    maximum: 0xffff
    description:
      TGain for the battery thermistor (with maxim,thermistor-toff). When both
      are given the gauge is set to measure the thermistor (Config.TEx cleared).

  maxim,thermistor-toff:
    $ref: /schemas/types.yaml#/definitions/uint32
    maximum: 0xffff
    description: TOff for the battery thermistor.

  maxim,thermistor-curve:
    $ref: /schemas/types.yaml#/definitions/uint32
    maximum: 0xffff
    description: Thermistor Curve register (M5 gauges such as the MAX77759).

required:
  - compatible
  - reg

unevaluatedProperties: false

examples:
  - |
    i2c {
      #address-cells = <1>;
      #size-cells = <0>;

      battery@36 {
        compatible = "maxim,max17042";
        reg = <0x36>;
        maxim,rsns-microohm = <10000>;
        maxim,over-heat-temp = <600>;
        maxim,over-volt = <4300>;
      };
    };
```

## drivers/media/platform/samsung/Kconfig
```kconfig
# SPDX-License-Identifier: GPL-2.0-only

comment "Samsung media platform drivers"

source "drivers/media/platform/samsung/exynos-gsc/Kconfig"
source "drivers/media/platform/samsung/exynos4-is/Kconfig"
source "drivers/media/platform/samsung/s3c-camif/Kconfig"
source "drivers/media/platform/samsung/s5p-g2d/Kconfig"
source "drivers/media/platform/samsung/s5p-jpeg/Kconfig"
source "drivers/media/platform/samsung/s5p-mfc/Kconfig"

config VIDEO_ZUMA_ISPFE_BRINGUP
	tristate "Tensor G3 ISP front end power bring-up"
	depends on OF && PM
	help
	  Hold the Tensor G3 camera front end (CSIS + PDMA) power domain and
	  bus clocks on demand, for bring-up work from userspace.
```
